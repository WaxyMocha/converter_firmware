/*
 * Display.cpp
 *
 * Created: 27.12.2016 02:08:33
 *  Author: Jakub
 */ 
 #include <avr/pgmspace.h>
 #include <avr/interrupt.h>
 #include <stdlib.h>
 #include "include/Extern_variables.h"
 #include "include/Display.h"

#define swap(a, b) { int16_t t = a; a = b; b = t; }

const uint8_t first[] PROGMEM = {
	 0x00,0x00,0x00,0x00,0x00,0x00,0x00,0x00,0x00,0x00,0x00,0x00,0x00,0x00,0x00,0x00,
	 0xEE,0x00,0x00,0x01,0xC7,0x00,0x00,0x00,0x00,0x00,0x00,0x00,0x00,0x00,0x00,0x00,
	 0x44,0x00,0x00,0x00,0xC6,0x00,0x00,0x00,0x00,0x00,0x00,0x00,0x00,0x00,0x00,0x00,
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	 0x00,0x00,0x00,0x00,0x00,0x00,0x00,0x00,0x00,0x00,0x00,0x00,0x00,0x00,0x00,0x00,
 }; // 128 x 32
const uint8_t second[] PROGMEM = {
	 0x00,0x00,0x00,0x00,0x00,0x00,0x00,0x00,0x00,0x00,0x00,0x00,0x00,0x00,0x00,0x00,
	 0xEE,0xE0,0x00,0x00,0x0E,0xEE,0x70,0x00,0x00,0x00,0x7F,0x00,0x00,0x00,0x00,0x00,
	 0x44,0x40,0x00,0x00,0x04,0x44,0x50,0x00,0x00,0x00,0x49,0x00,0x00,0x00,0x00,0x00,
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	 0x00,0x00,0x00,0x00,0x00,0x00,0x00,0x00,0x00,0x00,0x00,0x00,0x00,0x00,0x00,0x00,
 }; //128 x 32
const uint8_t FreeSans9pt7bBitmaps[] PROGMEM = {
	0xFF, 0xFF, 0xF8, 0xC0, 0xDE, 0xF7, 0x20, 0x09, 0x86, 0x41, 0x91, 0xFF,
	0x13, 0x04, 0xC3, 0x20, 0xC8, 0xFF, 0x89, 0x82, 0x61, 0x90, 0x10, 0x1F,
	0x14, 0xDA, 0x3D, 0x1E, 0x83, 0x40, 0x78, 0x17, 0x08, 0xF4, 0x7A, 0x35,
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	0x66, 0x67, 0x37, 0x66, 0x66, 0x66, 0xC0, 0x61, 0x24, 0x38 
	};
uint8_t screen[512] = {
	 0x00,0x00,0x00,0x00,0x00,0x00,0x00,0x00,0x00,0x00,0x00,0x00,0x00,0x00,0x00,0x00,
	 0xEE,0x00,0x00,0x01,0xC7,0x00,0x00,0x00,0x00,0x00,0x00,0x00,0x00,0x00,0x00,0x00,
	 0x44,0x00,0x00,0x00,0xC6,0x00,0x00,0x00,0x00,0x00,0x00,0x00,0x00,0x00,0x00,0x00,
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	 0x00,0x00,0x00,0x00,0x00,0x00,0x00,0x00,0x00,0x00,0x00,0x00,0x00,0x00,0x00,0x00,
	 };
uint16_t screen_counter = 0;
bool screen_send = true;

uint8_t buffer[32];
uint8_t buffer_counter = 0;

uint8_t control = 0;

int coursor_x;
int coursor_y;

void command(uint8_t c)
{
	buffer_counter++;
	buffer[buffer_counter] = c;
}
void Display_init ()
{
	command(SSD1306_DISPLAYOFF);                    // 0xAE
	command(SSD1306_SETDISPLAYCLOCKDIV);            // 0xD5
	command(0x80);                                  // the suggested ratio 0x80

	command(SSD1306_SETMULTIPLEX);                  // 0xA8
	command(SSD1306_LCDHEIGHT - 1);

	command(SSD1306_SETDISPLAYOFFSET);              // 0xD3
	command(0x0);                                   // no offset
	command(SSD1306_SETSTARTLINE | 0x0);            // line #0
	command(SSD1306_CHARGEPUMP); // 0x8D
	command(0x14);
	command(SSD1306_MEMORYMODE);                    // 0x20
	command(0x00);                                  // 0x0 act like ks0108
	command(SSD1306_SEGREMAP | 0x1);
	command(SSD1306_COMSCANDEC);
	command(SSD1306_SETCOMPINS);                    // 0xDA
	command(0x02);
	command(SSD1306_SETCONTRAST);                   // 0x81
	command(0x8F);
	command(SSD1306_SETPRECHARGE);
	command(0xF1);
	command(SSD1306_SETVCOMDETECT);                 // 0xDB
	command(0x40);
	command(SSD1306_DISPLAYALLON_RESUME);           // 0xA4
	command(SSD1306_NORMALDISPLAY);                 // 0xA6

	command(SSD1306_DEACTIVATE_SCROLL);

	command(SSD1306_DISPLAYON);//--turn on oled panel
}
void Display_invert(bool i)
{
	if (i) {
		command(SSD1306_INVERTDISPLAY);
	} else {
		command(SSD1306_NORMALDISPLAY);
	}
}
void Display_scroll (uint8_t start, uint8_t stop, bool right = true)
{
	if (right)
	{
		command(SSD1306_RIGHT_HORIZONTAL_SCROLL);
	} 
	else
	{
		command(SSD1306_LEFT_HORIZONTAL_SCROLL);
	}
	command(0X00);
	command(start);
	command(0X00);
	command(stop);
	command(0X00);
	command(0XFF);
	command(SSD1306_ACTIVATE_SCROLL);
}
void Display_diagonal_scroll (uint8_t start, uint8_t stop, bool right = true)
{
	command(SSD1306_SET_VERTICAL_SCROLL_AREA);
	command(0X00);
	command(SSD1306_LCDHEIGHT);
	if (right)
	{
		command(SSD1306_VERTICAL_AND_RIGHT_HORIZONTAL_SCROLL);
	} 
	else
	{
		command(SSD1306_VERTICAL_AND_LEFT_HORIZONTAL_SCROLL);
	}
	command(0X00);
	command(start);
	command(0X00);
	command(stop);
	command(0X01);
	command(SSD1306_ACTIVATE_SCROLL);
}
void Display_scroll_stop ()
{
	command(SSD1306_DEACTIVATE_SCROLL);
}
void Display_dim (bool dim)
{
	uint8_t contrast;

	if (dim) 
	{
		contrast = 0; // Dimmed display
	} 
	else 
	{
		contrast = 0xCF;
	}
	command(SSD1306_SETCONTRAST);
	command(contrast);
}
void Display_pixel(int x, int y, bool enable = true)
{
	if ((x < 0) || (x >= SSD1306_LCDWIDTH) || (y < 0) || (y >= SSD1306_LCDHEIGHT))
	{
		return;
	}
	if (enable)
	{
		screen[x + (y/8)*SSD1306_LCDWIDTH] |= (1<<(y%8));
	} 
	else
	{
		screen[x + (y/8)*SSD1306_LCDWIDTH] &= ~(1<<(y%8));
	}
}
void Display_send ()
{
	screen_send = true;
	control++;
	TWIC.MASTER.DATA = SSD1306_I2C_ADDRESS;// start twi transfer
}

void Display_line(int x0, int y0, int x1, int y1, bool enable)
{
	int steep = abs(y1 - y0) > abs(x1-x0);
	if (steep)
	{
		swap(x0, y0);
		swap(x1, y1);
	}
	if (x0 > x1)
	{
		swap(x0, x1);
		swap(y0, y1);
	}
	int dx, dy;
	dx = x1-x0;
	dy = abs(y1 - y0);

	int err = dx / 2;
	int ystep;

	if (y0 < y1)
	{
		ystep = -1;
	} 
	else
	{
		ystep = 1;
	}

	for (; x0 <= x1; x0++)
	{
		if (steep)
		{
			Display_pixel(y0, x0, enable);
		} 
		else
		{
			Display_pixel(x0, y0, enable);
		}
		err -= dy;
		if (err < 0)
		{
			y0 += ystep;
			err += dx;
		}
	}
}
void Display_veritcal_line(int x, int y, int h, bool enable)
{
	Display_line(x, y, x, y+h-1, enable);
}
void Display_bitmap_P (int x, int y, const uint8_t *bitmap, uint8_t w, uint8_t h, bool enable = true)
{
	int byteWidth = (w+7)/8;

	for (int i = 0; i<h; i++)
	{
		for (int j = 0; j<w; j++)
		{
			if (pgm_read_byte(bitmap + j * byteWidth + i / 8) & (128 >> (i & 7)))
			{
				Display_pixel(x+j, y+i, enable);
			}
		}
	}
}
void Display_fill_screen (bool enable)
{
	
}

void Display_char(int x, int y, char c, bool enable, bool background, uint8_t size)
{
	if ((x >= SSD1306_LCDWIDTH) || (y >= SSD1306_LCDHEIGHT) || ((x+6*size-1) < 0) || ((y+8*size-1) < 0)) return;

	uint8_t line;

	for (int8_t i=0; i<6; i++)
	{
		if (i == 5)
		{
			line = 0x0;
		}
		else
		{
			line = pgm_read_byte(FreeSans9pt7bBitmaps+(c*5)+1);
		}
		for (int8_t j = 0; j<8; j++)
		{
			if (line & 0x1)
			{
				if (size == 1)
				{
					Display_pixel(x+i, y+j, enable);
				}
				else
				{
					Display_fill_rect(x+(i*size), y+(j*size), size, size, enable);
				}
			}
			else if (background != enable)
			{
				if (size == 1)
				{
					Display_pixel(x+i, y+j, background);
				}
				else
				{
					Display_fill_rect(x+i*size, y+j*size, size, size, background);
				}
			}
			line >>= 1;
		}
	}
}
void Display_text (int x, int y, char * str, uint8_t txt_size, bool eanable, bool background)
{
	coursor_x = x;
	coursor_y = y;
	while (*str)
	{
		Display_char(coursor_x, coursor_y, *str++, eanable, background, txt_size);
		coursor_x += txt_size*6;
	}
}
void Display_int (int x, int y, int data, uint8_t txt_size, bool enable, bool background)
{
	char buf[16];
	Display_text(x, y, itoa(data, buf, 10), txt_size, enable, background);
}

void Display_fill_rect(int x, int y, int w, int h, bool enable)
{
	for (int16_t i = x; i<x+w; i++)
	{
		Display_veritcal_line(i, y, h, enable);
	}
}
void Display_rect (int x, int y, int w, int h, bool enable)
{
	#warning function empty
}
void Display_fill_circle(int x, int y, int r, bool enable)
{
	#warning function empty
}
void Display_circle (int x, int y, int r, bool enable)
{
	#warning function empty
}
void Display_fill_triangle (int x0, int y0, int x1, int y1, int x2, int y2, bool enable)
{
	#warning function empty
}
void Display_triangle (int x0, int y0, int x1, int y1, int x2, int y2, bool enable)
{
	#warning function empty
}
void Display_fill_round_rect (int x, int y, int w, int h, int r, bool enable)
{
	#warning function empty
}
void Display_round_rect (int x, int y, int w, int h, int r, bool enable)
{
	#warning function empty
}

